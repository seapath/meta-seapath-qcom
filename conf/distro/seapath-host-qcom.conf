## conf/distro/seapath-host-qcom.conf
```bitbake
# Copyright (C) 2026 Savoir-faire Linux, Inc.
# SPDX-License-Identifier: Apache-2.0

require conf/distro/seapath-host.conf

# Add dmaheap gid for useradd-qcom required for QCOM BSP
USERADD_GID_TABLES:append = " conf/distro/include/group-qcom.gid"

DISTRO_FEATURES:remove = 'seapath-clustering'

QEMU_TARGETS:pn-qemu:append = " aarch64"

IMAGE_CLASSES:append = " image_types_qcom"

unset SKIP_RECIPE[busybox]
```

## conf/machine/seapath-machine-common-qcom.inc
```bitbake
# Copyright (C) 2026 Savoir-faire Linux, Inc.
# SPDX-License-Identifier: Apache-2.0

MACHINEOVERRIDES =. "seapath:"
SERIAL_CONSOLES = "115200;ttyS0"
EFI_PROVIDER = "grub-efi"

# Kernel parameters
APPEND += " \
    audit=0 \
    slab_nomerge \
    slub_debug=ZF \
    rootfstype=ext4 \
    page_poison=on \
    spec_store_bypass_disable=auto \
    mds=full,nosmt \
    mce=0 \
    page_alloc.shuffle=1 \
    rng_core.default_quality=500 \
"

# Arm64 does not support compressed kernel
KERNEL_IMAGETYPE = "Image"
```
